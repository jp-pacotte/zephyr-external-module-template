## lib/tests/west.yml
```yaml
manifest:
  self:
    west-commands: scripts/west-commands.yml

  remotes:
    - name: zephyrproject-rtos
      url-base: https://github.com/zephyrproject-rtos

  projects:
    - name: zephyr
      remote: zephyrproject-rtos
      revision: v3.7.0
      import:
        name-allowlist:
          - cmsis      # required by the ARM port
          - hal_stm32  # required by the STM32 based boards
          - littlefs   # required by the LittleFS filesystem
```

## tests/bar/testcase.yaml
```yaml
tests:
  foolib.configuration:
    platform_allow:
      - native_sim
    integration_platforms:
      - native_sim
    tags: [lib, foolib]
```

## west.yml
```yaml
manifest:
  remotes:
    - name: zephyrproject-rtos
      url-base: https://github.com/zephyrproject-rtos
    - name: pa-cotte
      url-base: https://github.com/pa-cotte

  projects:
    - name: zephyr
      remote: zephyrproject-rtos
      revision: v3.7.0
```
